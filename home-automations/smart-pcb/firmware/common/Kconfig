## home-automations/smart-pcb/firmware/common/Kconfig
```kconfig
menu "Smart PCB"

    config SMART_PCB_LIGHT_SLEEP
        bool "Light-sleep between Thread polls"
        default y
        help
            Saves the battery. Turn it off to rule out sleep problems: the device then stays
            awake (still a sleepy Thread device that polls its parent).

    config SMART_PCB_BATTERY_INTERVAL_MIN
        int "Battery reading interval (minutes)"
        default 60
        help
            Besides a reading after every motor stop.

    config SMART_PCB_DIAGNOSTICS
        bool "Diagnostics switches: run the motor by hand"
        default y
        help
            Two more On/Off endpoints on every product, "Motor forward" and "Motor backward"
            (named after their endpoint in Home Assistant). While one is on, the motor runs that
            way: forward drives DRV8833 IN1 high, backward IN2. Switching it off, or the other
            one on, stops it; so does SMART_PCB_DIAGNOSTICS_MAX_RUN_MS. It bypasses the product,
            whose position is then off until its next full move (valve head) or until it is set
            again (Rollo: jog and set fully up / down).

    config SMART_PCB_DIAGNOSTICS_MAX_RUN_MS
        int "Longest a diagnostics switch runs the motor (ms)"
        depends on SMART_PCB_DIAGNOSTICS
        range 100 120000
        default 10000

endmenu
```

## home-automations/smart-pcb/firmware/components/smart_pcb/Kconfig
```kconfig
menu "Smart PCB"

    config SMART_PCB_LIGHT_SLEEP
        bool "Light-sleep between Thread polls"
        default y
        help
            Saves the battery. Turn it off to rule out sleep problems: the device then stays
            awake (still a sleepy Thread device that polls its parent).

    config SMART_PCB_BATTERY_INTERVAL_MIN
        int "Battery reading interval (minutes)"
        default 60
        help
            For products that report the battery (device_add_battery()).

endmenu
```

## home-automations/smart-pcb/firmware/products/diy-valve-head/Kconfig
```kconfig
menu "Valve head"

    config VALVE_TRAVEL_MS
        int "Motor run time for a full stroke (ms)"
        default 3300
        help
            Time the lock motor needs for the 7.1 mm stroke (scaled from 1600 ms for 3.4 mm). Measure it once; the motor
            runs this long plus VALVE_OVERRUN_MS and then stalls against the hard stop.

    config VALVE_OVERRUN_MS
        int "Extra run time against the hard stop (ms)"
        default 500

    config VALVE_REVERSE_DEFAULT
        bool "Swap motor direction by default"
        default n
        help
            Same as swapping the two motor wires. This is only the factory default of the
            "Reverse direction" switch the device exposes over Matter; once that switch has
            been set, its stored value wins.

endmenu
```

## home-automations/smart-pcb/firmware/products/motor-rollo/Kconfig
```kconfig
# Rollo settings (products/Kconfig sources this file)
menu "Rollo"
    depends on PRODUCT_MOTOR_ROLLO

    config ROLLO_TRAVEL_UP_MS
        int "Run time from fully down to fully up (ms)"
        default 30000
        help
            There is no encoder: the position comes from the motor's run time. Time a full
            run up once and enter it here.

    config ROLLO_TRAVEL_DOWN_MS
        int "Run time from fully up to fully down (ms)"
        default 30000
        help
            Time a full run down once and enter it here. It can differ from the run up
            (the bottom bar pulls with it going down); if it doesn't, enter the same time.

    config ROLLO_VIRTUAL_MAX_PERCENT
        int "Virtual fully down (% of the full run down)"
        range 1 100
        default 100
        help
            Where "fully closed" is, as a share of the full height timed above. With 80,
            closing stops at 80 % of the full run, and Matter's 0-100 % spans only that
            range: 50 % is 40 % of the full height. Change it without measuring the travel
            times again; the saved position stays where the blind really is.

    config ROLLO_JOG_MS
        int "Jog run time (ms)"
        range 50 10000
        default 1000
        help
            How long the jog up / jog down switches run the motor. A jog ignores fully up
            and the virtual fully down, so an out-of-step blind can be brought to the real
            top and set as fully up there.

    config ROLLO_TOP_OVERRUN_MS
        int "Extra run time past fully up (ms)"
        default 0
        help
            Only if the bottom bar stops against the head and the motor can stall there
            safely: then every move to fully up runs this much longer and corrects the drift
            of time-based positioning. Leave it at 0 if nothing stops the fabric at the top.

    config ROLLO_REVERSE
        bool "Swap motor direction"
        default n
        help
            Same as swapping the two motor wires. The direction can also be swapped over
            Matter, without flashing (the MotorDirectionReversed bit of the Window Covering
            Mode attribute); the two add up.

endmenu
```
